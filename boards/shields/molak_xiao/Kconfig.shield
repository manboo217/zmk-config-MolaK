## boards/shields/molak_xiao/Kconfig.shield
```kconfig
config SHIELD_MOLAK_XIAO_RIGHT
   def_bool $(shields_list_contains, molak_xiao_right)
config SHIELD_MOLAK_XIAO_LEFT
   def_bool $(shields_list_contains, molak_xiao_left)
```

## config/boards/shields/Molak/Kconfig.defconfig
```kconfig
if SHIELD_MOLAK_R

config ZMK_KEYBOARD_NAME
    default "Molak"

config ZMK_SPLIT
    default y

config ZMK_SPLIT_ROLE_CENTRAL
    default y

endif

if SHIELD_MOLAK_L

config ZMK_SPLIT
    default y

endif
```

## config/boards/shields/Molak/Kconfig.shield
```kconfig
config SHIELD_MONA_R
    def_bool $(shields_list_contains,Molak_R)

config SHIELD_MONA_L
    def_bool $(shields_list_contains,Molak_L)
```
