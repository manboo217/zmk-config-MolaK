#include "molak_xiao.dtsi"

&kscan0 {
    col-gpios
        = <&xiao_d 3 GPIO_ACTIVE_HIGH>
        , <&gpio1  1 GPIO_ACTIVE_HIGH>
        , <&xiao_d 10 GPIO_ACTIVE_HIGH>
        , <&xiao_d 9 GPIO_ACTIVE_HIGH>
        ;
};

&left_encoder {
    status = "okay";
};
