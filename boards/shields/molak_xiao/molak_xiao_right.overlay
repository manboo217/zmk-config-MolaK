#include "molak_xiao.dtsi"

&default_transform {
    col-offset = <7>;
};

&kscan0 {
    col-gpios
        = <&xiao_d 3 GPIO_ACTIVE_HIGH>
        , <&gpio1  1 GPIO_ACTIVE_HIGH>
        , <&xiao_d 10 GPIO_ACTIVE_HIGH>
        , <&xiao_d 9 GPIO_ACTIVE_HIGH>
        ;
};

&right_encoder {
    status = "okay";
};
